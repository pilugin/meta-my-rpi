## conf/layer.conf
```bitbake
# We have a conf and classes directory, add to BBPATH
BBPATH .= ":${LAYERDIR}"

# We have recipes-* directories, add to BBFILES
BBFILES += "${LAYERDIR}/recipes-*/*/*.bb \
            ${LAYERDIR}/recipes-*/*/*.bbappend \
            ${LAYERDIR}/extends*/*/*.bb \
            ${LAYERDIR}/extends*/*/*.bbappend"

BBFILE_COLLECTIONS += "meta-my-rpi"
BBFILE_PATTERN_meta-my-rpi = "^${LAYERDIR}/"
BBFILE_PRIORITY_meta-my-rpi = "6"

LAYERVERSION_meta-my-rpi = "1"

LAYERDEPENDS_meta-my-rpi = "core"
LAYERDEPENDS_meta-my-rpi += "openembedded-layer"

LAYERSERIES_COMPAT_meta-my-rpi = "dunfell"
```

## meta-my-rpi/wic/sdimage-astro-64G.wks
```
part /boot --source bootimg-partition --ondisk mmcblk0 --fstype=vfat --label boot --active --align 4096 --size 20
part / --source rootfs --ondisk mmcblk0 --fstype=ext4 --label root --align 4096 --fixed-size 1024
part /home --ondisk mmcblk0 --fstype=ext4 --label home --align 4096 --size 59826
```
